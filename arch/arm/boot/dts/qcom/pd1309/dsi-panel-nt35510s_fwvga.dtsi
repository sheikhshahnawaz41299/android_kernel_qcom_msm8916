/* Copyright (c) 2020, The Linux Foundation. All rights reserved.
*  Copyright (c) 2020, the_shahnawaz_sheikh (sheikhshahnawaz41299).
*
* This program is free software; you can redistribute it and/or modify
* it under the terms of the GNU General Public License version 2 and
* only version 2 as published by the Free Software Foundation.
*
* This program is distributed in the hope that it will be useful,
* but WITHOUT ANY WARRANTY; without even the implied warranty of
* MERCHANTABILITY or FITNESS FOR A PARTICULAR PURPOSE.  See the
* GNU General Public License for more details.
*/

&mdss_mdp {

		dsi_nt35510s_fwvga: qcom,mdss_dsi_nt35510s_fwvga_cmd_tm {
				qcom,mdss-dsi-panel-name = "tmnt35510s fwvga command mode dsi panel";
				qcom,mdss-dsi-project-name = "pd1309f_ex";
				qcom,mdss-dsi-panel-controller = <&mdss_dsi0>;
				qcom,mdss-dsi-panel-type = "dsi_cmd_mode";
				qcom,mdss-dsi-panel-destination = "display_1";
				qcom,mdss-dsi-panel-framerate = <60>;
				qcom,mdss-dsi-virtual-channel-id = <0>;
				qcom,mdss-dsi-stream = <0>;
				qcom,mdss-dsi-panel-id = <17>;
				qcom,mdss-dsi-panel-width = <480>;
				qcom,mdss-dsi-panel-height = <854>;
				qcom,mdss-dsi-h-front-porch = <76>;
				qcom,mdss-dsi-h-back-porch = <76>;
				qcom,mdss-dsi-h-pulse-width = <70>;
				qcom,mdss-dsi-h-sync-skew = <0>;
				qcom,mdss-dsi-v-back-porch = <27>;
				qcom,mdss-dsi-v-front-porch = <6>;
				qcom,mdss-dsi-v-pulse-width = <5>;
				qcom,mdss-dsi-h-left-border = <0>;
				qcom,mdss-dsi-h-right-border = <0>;
				qcom,mdss-dsi-v-top-border = <0>;
				qcom,mdss-dsi-v-bottom-border = <0>;
				qcom,mdss-dsi-bpp = <24>;
				qcom,mdss-dsi-underflow-color = <225>;
				qcom,mdss-dsi-border-color = <0>;
				qcom,mdss-dsi-on-command = [29 01 00 00 00 00 05 ff aa 55 a5 80 29 01 00 00 00 00 02 6f 02 29 01 00 00 00 00 02 f2 08 29 01 00 00 00 00 02 6f 07 29 01 00 00 00 00 02 f7 28 29 01 00 00 00 00 05 ff aa 55 a5 00 29 01 00 00 00 00 06 f0 55 aa 52 08 01 29 01 00 00 00 00 04 b6 34 44 44 29 01 00 00 00 00 04 b0 0f 0f 0f 29 01 00 00 00 00 04 b7 24 34 34 29 01 00 00 00 00 04 b1 0f 0f 0f 29 01 00 00 00 00 04 b8 24 24 24 29 01 00 00 00 00 02 bf 01 29 01 00 00 00 00 04 b2 00 00 00 29 01 00 00 00 00 04 b3 08 08 08 29 01 00 00 00 00 04 b5 08 08 08 29 01 00 00 00 00 04 b9 34 34 34 29 01 00 00 00 00 04 ba 14 14 14 29 01 00 00 00 00 04 bc 00 78 00 29 01 00 00 00 00 04 bd 00 78 00 29 01 00 00 00 00 35 d1 00 00 00 9b 00 c3 00 e1 00 f8 01 1c 01 3a 01 68 01 8c 01 c4 01 f0 02 37 02 71 02 73 02 a4 02 d9 02 fa 03 2a 03 48 03 71 03 8b 03 b3 03 cb 03 de 03 f7 03 ff 29 01 00 00 00 00 35 d2 01 4e 01 54 01 5e 01 69 01 73 01 84 01 94 01 b0 01 c5 01 ee 02 12 02 4e 02 80 02 82 02 af 02 e3 03 02 03 33 03 50 03 7a 03 95 03 b8 03 cc 03 e3 03 fe 03 ff 29 01 00 00 00 00 35 d3 00 f1 00 fa 01 0a 01 1a 01 28 01 40 01 57 01 7d 01 98 01 ca 01 f5 02 39 02 71 02 73 02 a5 02 d9 02 f9 03 2a 03 49 03 79 03 a1 03 d8 03 e0 03 e2 03 fb 03 ff 29 01 00 00 00 00 35 d4 00 00 00 9b 00 c3 00 e1 00 f8 01 1c 01 3a 01 68 01 8c 01 c4 01 f0 02 37 02 71 02 73 02 a4 02 d9 02 fa 03 2a 03 48 03 71 03 8b 03 b3 03 cb 03 de 03 f7 03 ff 29 01 00 00 00 00 35 d5 01 4e 01 54 01 5e 01 69 01 73 01 84 01 94 01 b0 01 c5 01 ee 02 12 02 4e 02 80 02 82 02 af 02 e3 03 02 03 33 03 50 03 7a 03 95 03 b8 03 cc 03 e3 03 fe 03 ff 29 01 00 00 00 00 35 d6 00 f1 00 fa 01 0a 01 1a 01 28 01 40 01 57 01 7d 01 98 01 ca 01 f5 02 39 02 71 02 73 02 a5 02 d9 02 f9 03 2a 03 49 03 79 03 a1 03 d8 03 e0 03 e2 03 fb 03 ff 29 01 00 00 00 00 06 f0 55 aa 52 08 00 29 01 00 00 00 00 03 b1 ec 00 29 01 00 00 00 00 02 b5 6b 29 01 00 00 00 00 02 b6 05 29 01 00 00 00 00 03 b7 00 00 29 01 00 00 00 00 05 b8 01 07 07 07 29 01 00 00 00 00 04 bc 00 00 00 29 01 00 00 00 00 02 c1 19 29 01 00 00 00 00 0b c9 40 82 00 aa aa 81 c7 4b d8 05 29 01 00 00 00 00 02 35 00 29 01 00 00 00 00 05 2a 00 00 01 df 29 01 00 00 00 00 05 2b 00 00 03 55 29 01 00 00 00 00 05 bd 01 84 0c 1b 39 01 00 00 00 00 02 35 00 05 01 00 00 78 00 02 11 00 05 01 00 00 14 00 02 29 00];
				qcom,mdss-dsi-off-command = [05 01 00 00 32 00 02 28 00 05 01 00 00 78 00 02 10 00];
				qcom,mdss-dsi-on-command-state = "dsi_lp_mode";
				qcom,mdss-dsi-off-command-state = "dsi_lp_mode";
				qcom,mdss-dsi-h-sync-pulse = <0x1>;
				qcom,mdss-dsi-traffic-mode = "burst_mode";
				qcom,mdss-dsi-bllp-eof-power-mode;
				qcom,mdss-dsi-bllp-power-mode;
				qcom,mdss-dsi-lane-0-state;
				qcom,mdss-dsi-lane-1-state;
				qcom,mdss-dsi-lp11-init;
				qcom,mdss-dsi-init-delay-us = <0x2710>;
				qcom,mdss-dsi-te-pin-select = <0x18>;
				qcom,mdss-dsi-wr-mem-start = <0x2c>;
				qcom,mdss-dsi-te-dcs-command = <0x1>;
				qcom,mdss-dsi-te-check-enable;
				qcom,mdss-dsi-te-using-te-pin;
				qcom,mdss-dsi-panel-timings = <0x831c1200 0x40421828 0x23030400>;
				qcom,mdss-dsi-t-clk-post = <0x4>;
				qcom,mdss-dsi-t-clk-pre = <0x1b>;
				qcom,mdss-dsi-bl-min-level = <0x1>;
				qcom,mdss-dsi-bl-max-level = <0xff>;
				qcom,mdss-dsi-dma-trigger = "trigger_sw";
				qcom,mdss-dsi-mdp-trigger = "none";
				qcom,mdss-dsi-bl-pmic-control-type = "bl_ctrl_pwm";
				qcom,mdss-dsi-reset-sequence = <0x1 0xa 0x0 0xa 0x1 0x28>;
				qcom,mdss-pan-physical-width-dimension = <0x37>;
				qcom,mdss-pan-physical-height-dimension = <0x62>;
				qcom,mdss-dsi-bl-pmic-pwm-frequency = <0x19>;
				qcom,mdss-dsi-bl-pmic-bank-select = <0x0>;
				qcom,mdss-dsi-pwm-gpio = <0x5d 0x4 0x0>;
				qcom,cont-splash-enabled;
			};
};

