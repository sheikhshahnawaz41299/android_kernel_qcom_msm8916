/* Copyright (c) 2020,the_shahnawaz_sheikh, The Linux Foundation. All rights reserved.
*
* This program is free software; you can redistribute it and/or modify
* it under the terms of the GNU General Public License version 2 and
* only version 2 as published by the Free Software Foundation.
*
* This program is distributed in the hope that it will be useful,
* but WITHOUT ANY WARRANTY; without even the implied warranty of
* MERCHANTABILITY or FITNESS FOR A PARTICULAR PURPOSE.  See the
* GNU General Public License for more details.
*/

&mdss_mdp {

		dsi_orise8012a_tmfwvga_cmd_bkg: qcom,mdss_dsi_orise8012a_tmfwvga_cmd_bkg {
				qcom,mdss-dsi-panel-name = "orise8012a tmfwvga command mode dsi panel";
				qcom,mdss-dsi-project-name = "pd1309f_ex";
				qcom,mdss-dsi-panel-controller = <&mdss_dsi0>;
				qcom,mdss-dsi-panel-type = "dsi_cmd_mode";
				qcom,mdss-dsi-panel-destination = "display_1";
				qcom,mdss-dsi-panel-framerate = <60>;
				qcom,mdss-dsi-virtual-channel-id = <0>;
				qcom,mdss-dsi-stream = <0>;
				qcom,mdss-dsi-panel-id = <18>;
				qcom,mdss-dsi-panel-width = <480>;
				qcom,mdss-dsi-panel-height = <854>;
				qcom,mdss-dsi-h-front-porch = <76>;
				qcom,mdss-dsi-h-back-porch = <76>;
				qcom,mdss-dsi-h-pulse-width = <70>;
				qcom,mdss-dsi-h-sync-skew = <0>;
				qcom,mdss-dsi-v-back-porch = <27>;
				qcom,mdss-dsi-v-front-porch = <6>;
				qcom,mdss-dsi-v-pulse-width = <5>;
				qcom,mdss-dsi-h-left-border = <0>;
				qcom,mdss-dsi-h-right-border = <0>;
				qcom,mdss-dsi-v-top-border = <0>;
				qcom,mdss-dsi-v-bottom-border = <0>;
				qcom,mdss-dsi-bpp = <24>;
				qcom,mdss-dsi-underflow-color = <225>;
				qcom,mdss-dsi-border-color = <0>;
				qcom,mdss-dsi-on-command = [39 01 00 00 00 00 02 00 00 39 01 00 00 00 00 04 ff 80 12 01 39 01 00 00 00 00 02 00 80 39 01 00 00 00 00 03 ff 80 12 39 01 00 00 00 00 02 00 b4 39 01 00 00 00 00 02 c0 55 39 01 00 00 00 00 02 00 90 39 01 00 00 00 00 04 c5 02 76 01 39 01 00 00 00 00 02 00 00 39 01 00 00 00 00 03 d8 6a 6a 39 01 00 00 00 00 02 00 81 39 01 00 00 00 00 02 c0 57 39 01 00 00 00 00 02 00 90 39 01 00 00 00 00 02 b3 02 39 01 00 00 00 00 02 00 80 39 01 00 00 00 00 03 c1 25 55 39 01 00 00 00 00 02 00 81 39 01 00 00 00 00 02 c4 83 39 01 00 00 00 00 02 00 82 39 01 00 00 00 00 02 c5 a0 39 01 00 00 00 00 02 00 b1 39 01 00 00 00 00 02 c5 20 39 01 00 00 00 00 02 00 c6 39 01 00 00 00 00 02 b0 01 39 01 00 00 00 00 02 00 80 39 01 00 00 00 00 0d ce 8a 03 00 89 03 00 88 03 00 87 03 00 39 01 00 00 00 00 02 00 90 39 01 00 00 00 00 0d ce 38 0e 00 38 0d 00 00 00 00 00 00 00 39 01 00 00 00 00 02 00 a0 39 01 00 00 00 00 0f ce 38 06 03 56 00 18 00 38 05 03 57 00 18 00 39 01 00 00 00 00 02 00 b0 39 01 00 00 00 00 0f ce 38 04 03 58 00 18 00 38 03 03 59 00 18 00 39 01 00 00 00 00 02 00 c0 39 01 00 00 00 00 0f ce 38 02 03 5a 00 18 00 38 01 03 5b 00 18 00 39 01 00 00 00 00 02 00 d0 39 01 00 00 00 00 0f ce 38 00 03 5c 00 18 00 30 00 03 5d 00 18 00 39 01 00 00 00 00 02 00 c0 39 01 00 00 00 00 0c cf 02 02 20 20 00 00 01 00 00 00 00 39 01 00 00 00 00 02 00 c0 39 01 00 00 00 00 10 cb 15 15 00 00 15 15 15 15 15 15 15 00 00 00 00 39 01 00 00 00 00 02 00 d0 39 01 00 00 00 00 10 cb 00 00 00 00 00 00 00 00 00 00 15 15 15 15 15 39 01 00 00 00 00 02 00 e0 39 01 00 00 00 00 0b cb 15 15 00 00 15 15 00 00 00 00 39 01 00 00 00 00 02 00 80 39 01 00 00 00 00 0b cc 26 25 00 00 0c 0a 10 0e 02 04 39 01 00 00 00 00 02 00 90 39 01 00 00 00 00 10 cc 06 00 00 00 00 00 00 00 00 00 00 00 00 00 00 39 01 00 00 00 00 02 00 a0 39 01 00 00 00 00 10 cc 05 03 01 0d 0f 09 0b 00 00 25 26 00 00 00 00 39 01 00 00 00 00 02 00 b0 39 01 00 00 00 00 0b cc 25 26 00 00 0b 0d 0f 09 01 03 39 01 00 00 00 00 02 00 c0 39 01 00 00 00 00 10 cc 05 00 00 00 00 00 00 00 00 00 00 00 00 00 00 39 01 00 00 00 00 02 00 d0 39 01 00 00 00 00 10 cc 06 04 02 0a 10 0e 0c 00 00 26 25 00 00 00 00 39 01 00 00 00 00 02 00 00 39 01 00 00 00 00 15 e1 10 47 55 5a 69 76 7a a4 93 ab 59 44 57 34 32 23 16 0b 05 03 39 01 00 00 00 00 02 00 00 39 01 00 00 00 00 15 e2 10 47 55 59 68 77 7a a4 93 ac 58 44 57 34 32 24 16 0b 05 03 39 01 00 00 00 00 02 00 00 39 01 00 00 00 00 22 ec 40 44 43 44 44 43 44 44 34 44 44 34 44 44 34 44 44 44 43 44 44 43 44 44 34 44 44 34 44 44 34 44 04 39 01 00 00 00 00 02 00 00 39 01 00 00 00 00 22 ed 40 44 43 44 44 34 44 44 44 43 44 44 34 44 44 44 34 44 44 44 43 44 44 34 44 44 44 43 44 44 34 44 04 39 01 00 00 00 00 02 00 00 39 01 00 00 00 00 22 ee 40 44 44 44 44 44 44 44 44 44 44 44 44 44 44 44 44 44 44 44 44 44 44 44 44 44 44 44 44 44 44 44 04 39 01 00 00 00 00 02 00 83 39 01 00 00 00 00 02 c1 50 39 01 00 00 00 00 02 00 80 39 01 00 00 00 00 02 c4 30 39 01 00 00 00 00 02 00 8a 39 01 00 00 00 00 02 c4 40 39 01 00 00 00 00 02 00 92 39 01 00 00 00 00 02 c4 08 39 01 00 00 00 00 02 00 b1 39 01 00 00 00 00 02 b0 b2 39 01 00 00 00 00 02 00 91 39 01 00 00 00 00 02 c1 08 39 01 00 00 00 00 02 00 aa 39 01 00 00 00 00 02 c0 aa 39 01 00 00 00 00 02 00 d0 39 01 00 00 00 00 02 c0 c0 39 01 00 00 00 00 02 00 80 39 01 00 00 00 00 03 ff ff ff 39 01 00 00 00 00 02 00 00 39 01 00 00 00 00 04 ff ff ff ff 39 01 00 00 00 00 02 00 00 39 01 00 00 00 00 03 99 35 45 05 01 00 00 00 00 02 35 00 05 01 00 00 78 00 02 11 00 05 01 00 00 14 00 02 29 00 39 01 00 00 00 00 02 00 00 39 01 00 00 00 00 03 99 00 00];
				qcom,mdss-dsi-off-command = <0x39010000 0x200 0x390100 0x3 0x99354505 0x1000032 0x22800 0x5010000 0x78000210 0x390100 0x2 0x3901 0x0 0x3990000>;
				qcom,mdss-dsi-on-command-state = "dsi_lp_mode";
				qcom,mdss-dsi-off-command-state = "dsi_lp_mode";
				qcom,mdss-dsi-h-sync-pulse = <0x1>;
				qcom,mdss-dsi-traffic-mode = "burst_mode";
				qcom,mdss-dsi-bllp-eof-power-mode;
				qcom,mdss-dsi-bllp-power-mode;
				qcom,mdss-dsi-lane-0-state;
				qcom,mdss-dsi-lane-1-state;
				qcom,mdss-dsi-lp11-init;
				qcom,mdss-dsi-init-delay-us = <0x2710>;
				qcom,mdss-dsi-te-pin-select = <0x18>;
				qcom,mdss-dsi-wr-mem-start = <0x2c>;
				qcom,mdss-dsi-te-dcs-command = <0x1>;
				qcom,mdss-dsi-te-check-enable;
				qcom,mdss-dsi-te-using-te-pin;
				qcom,mdss-dsi-panel-timings = <0x831c1200 0x40421828 0x23030400>;
				qcom,mdss-dsi-t-clk-post = <0x4>;
				qcom,mdss-dsi-t-clk-pre = <0x1b>;
				qcom,mdss-dsi-bl-min-level = <0x1>;
				qcom,mdss-dsi-bl-max-level = <0xff>;
				qcom,mdss-dsi-dma-trigger = "trigger_sw";
				qcom,mdss-dsi-mdp-trigger = "none";
				qcom,mdss-dsi-bl-pmic-control-type = "bl_ctrl_pwm";
				qcom,mdss-dsi-reset-sequence = <0x1 0x14 0x0 0x14 0x1 0x14>;
				qcom,mdss-dsi-bl-pmic-pwm-frequency = <0x19>;
				qcom,mdss-dsi-bl-pmic-bank-select = <0x0>;
				qcom,mdss-dsi-pwm-gpio = <0x5d 0x4 0x0>;
				qcom,cont-splash-enabled;
			};
};

