/* Copyright (c) 2018, The Linux Foundation. All rights reserved.
*  Copyright (c) 2020, the_shahnawaz_sheikh (sheikhshahnawaz41299).
*
* This program is free software; you can redistribute it and/or modify
* it under the terms of the GNU General Public License version 2 and
* only version 2 as published by the Free Software Foundation.
*
* This program is distributed in the hope that it will be useful,
* but WITHOUT ANY WARRANTY; without even the implied warranty of
* MERCHANTABILITY or FITNESS FOR A PARTICULAR PURPOSE.  See the
* GNU General Public License for more details.
*/

&mdss_mdp {
	dsi_boehx8389c_qHD_video: qcom,mdss_dsi_boehx8389c_qHD_video {
				qcom,mdss-dsi-panel-name = "boehx8389c qHD video mode dsi panel";
				qcom,mdss-dsi-project-name = "pd1510";
				qcom,mdss-dsi-panel-controller = <&mdss_dsi0>;
				qcom,mdss-dsi-panel-type = "dsi_video_mode";
				qcom,mdss-dsi-panel-destination = "display_1";
				qcom,mdss-dsi-panel-framerate = <60>;
				qcom,mdss-dsi-virtual-channel-id = <0>;
				qcom,mdss-dsi-stream = <0>;
				qcom,mdss-dsi-panel-id = <49>;
				qcom,mdss-dsi-panel-width = <540>;
				qcom,mdss-dsi-panel-height = <960>;
				qcom,mdss-dsi-h-front-porch = <35>;
				qcom,mdss-dsi-h-back-porch = <0x5a>;
				qcom,mdss-dsi-h-pulse-width = <90>;
				qcom,mdss-dsi-h-sync-skew = <0>;
				qcom,mdss-dsi-v-back-porch = <16>;
				qcom,mdss-dsi-v-front-porch = <14>;
				qcom,mdss-dsi-v-pulse-width = <2>;
				qcom,mdss-dsi-h-left-border = <0>;
				qcom,mdss-dsi-h-right-border = <0>;
				qcom,mdss-dsi-v-top-border = <0>;
				qcom,mdss-dsi-v-bottom-border = <0>;
				qcom,mdss-dsi-bpp = <24>;
				qcom,mdss-dsi-underflow-color = <255>;
				qcom,mdss-dsi-border-color = <0>;
				qcom,mdss-dsi-pixel-packing = "tight";
				qcom,mdss-dsi-on-command = [39 01 00 00 00 00 04 b9 ff 83 89 39 01 00 00 00 00 11 b1 7f 0a 0a 31 51 50 d0 ec 9c 80 20 20 f8 aa aa a3 39 01 00 00 00 00 0b b2 80 50 05 03 50 38 11 64 55 09 39 01 00 00 00 00 0c b4 77 5e 77 5e 77 5e 0e 72 0e 72 8e 39 01 00 00 00 00 24 d3 00 00 00 00 00 08 08 32 10 00 00 00 03 ca 03 ca 00 00 00 00 27 22 01 01 23 00 00 00 05 08 00 00 0a 00 01 39 01 00 00 00 00 27 d5 18 18 18 18 18 18 01 00 03 02 19 19 19 19 21 20 18 18 18 18 18 18 18 18 18 18 18 18 18 18 18 18 18 18 18 18 18 18 39 01 00 00 00 00 27 d6 18 18 18 18 18 18 02 03 00 01 19 19 18 18 20 21 19 19 18 18 18 18 18 18 18 18 18 18 18 18 18 18 18 18 18 18 18 18 39 01 00 00 00 00 2b e0 05 0a 0b 2c 35 3f 11 34 04 08 0b 17 0e 11 14 13 14 09 11 14 17 05 0a 0b 2c 35 3f 11 34 04 08 0b 17 0e 11 14 13 14 09 11 14 17 39 01 00 00 00 00 03 b6 44 44 39 01 00 00 00 00 02 bd 00 39 01 00 00 00 00 2c c1 01 00 08 10 18 20 2a 31 39 41 49 51 59 61 68 6f 77 7e 85 8d 94 9c a4 ad b5 bc c4 cd d7 de e6 ee f7 ff 15 b0 45 28 73 60 b4 47 c0 39 01 00 00 00 00 02 bd 01 39 01 00 00 00 00 2b c1 00 08 0f 17 1f 2a 30 37 40 47 4f 57 5f 66 6d 74 7b 82 89 8f 97 9e a6 ae b5 bc c3 cb d4 dc e3 ea f2 0e 57 7a 15 03 60 af 86 40 39 01 00 00 00 00 02 bd 02 39 01 00 00 00 00 2b c1 00 08 10 18 20 2b 31 3a 43 4b 53 5c 63 6b 72 7a 81 88 90 97 9f a7 b0 b7 bf c7 d0 d8 e0 e7 ee f7 ff 16 ef 4c d8 77 f7 13 2e c0 39 01 00 00 00 00 02 bd 00 39 01 00 00 00 00 02 d2 77 39 01 00 00 00 00 02 cc 02 39 01 00 00 00 00 05 c7 00 80 60 c0 05 01 00 00 78 00 02 11 00 05 01 00 00 14 00 02 29 00];
				qcom,mdss-dsi-off-command = [05 01 00 00 14 00 02 28 00 05 01 00 00 78 00 02 10 00];
				qcom,mdss-dsi-on-command-state = "dsi_lp_mode";
				qcom,mdss-dsi-off-command-state = "dsi_hs_mode";
				qcom,mdss-dsi-h-sync-pulse = <1>;
				qcom,mdss-dsi-traffic-mode = "burst_mode";
				qcom,mdss-dsi-bllp-eof-power-mode;
				qcom,mdss-dsi-bllp-power-mode;
				qcom,mdss-dsi-hbp-power-mode;
				qcom,mdss-dsi-lane-0-state;
				qcom,mdss-dsi-lane-1-state;
				qcom,mdss-dsi-panel-timings = <0x8b1e1400 0x42461823 0x1b030400>;
				qcom,mdss-dsi-t-clk-post = <0x4>;
				qcom,mdss-dsi-t-clk-pre = <0x1b>;
				qcom,mdss-dsi-lp11-init;
				qcom,mdss-dsi-init-delay-us = <10000>;
				qcom,mdss-dsi-bl-min-level = <1>;
				qcom,mdss-dsi-bl-max-level = <255>;
				qcom,mdss-dsi-dma-trigger = "trigger_sw";
				qcom,mdss-dsi-mdp-trigger = "none";
				qcom,mdss-dsi-reset-sequence = <1 20>, <0 20>, <1 25>;
				qcom,mdss-pan-physical-width-dimension = <69>;
				qcom,mdss-pan-physical-height-dimension = <121>;
				qcom,mdss-dsi-bl-pmic-control-type = "bl_ctrl_pwm";
				qcom,mdss-dsi-bl-pmic-pwm-frequency = <25>;
				qcom,mdss-dsi-bl-pmic-bank-select = <0>;
				qcom,mdss-dsi-pwm-gpio = <&pm8916_mpps 4 0>;
				qcom,cont-splash-enabled;
			};
};
